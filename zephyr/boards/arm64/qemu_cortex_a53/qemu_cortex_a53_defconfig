## zephyr/boards/arm64/qemu_cortex_a53/qemu_cortex_a53_defconfig
```kconfig
CONFIG_SOC_QEMU_CORTEX_A53=y
CONFIG_BOARD_QEMU_CORTEX_A53=y
CONFIG_ARM_ARCH_TIMER=y

# Cache management
CONFIG_CACHE_MANAGEMENT=y

# Enable UART driver
CONFIG_SERIAL=y

# Enable console
CONFIG_CONSOLE=y
CONFIG_UART_CONSOLE=y

# Enable serial port
CONFIG_UART_INTERRUPT_DRIVEN=y

# Avoid timing skew in tests
CONFIG_QEMU_ICOUNT=y
CONFIG_QEMU_ICOUNT_SHIFT=4
CONFIG_QEMU_ICOUNT_SLEEP=y
CONFIG_SYS_CLOCK_EXISTS=y
CONFIG_CORTEX_M_SYSTICK=y
CONFIG_TICKLESS_KERNEL=y
CONFIG_SYS_CLOCK_HW_CYCLES_PER_SEC=4000000000
```

## zephyr/boards/arm64/roc_rk3568_pc/roc_rk3568_pc_defconfig
```kconfig
# SPDX-License-Identifier: Apache-2.0

# Platform Configuration
CONFIG_SOC_SERIES_RK3568=y
CONFIG_SOC_RK3568=y
CONFIG_BOARD_ROC_RK3568_PC=y
CONFIG_ARM_ARCH_TIMER=y

# Serial Drivers
CONFIG_SERIAL=y
CONFIG_UART_NS16550=y
CONFIG_UART_INTERRUPT_DRIVEN=y
CONFIG_NS16650_EARLYPRINT_DEBUG=n

# Enable console
CONFIG_CONSOLE=y
CONFIG_UART_CONSOLE=y

CONFIG_CLOCK_CONTROL=n

# SMP support
CONFIG_SMP=n
CONFIG_MP_NUM_CPUS=1
CONFIG_MP_MAX_NUM_CPUS=1
CONFIG_ARMV8_A_NS=y
CONFIG_CACHE_MANAGEMENT=y

CONFIG_PM=y
CONFIG_PM_CPU_OPS=y
CONFIG_PM_CPU_OPS_PSCI=y

# 24 MHz system clock, For uart2 1.2Ghz -> 24Mhz -> 1.5Mhz
CONFIG_SYS_CLOCK_EXISTS=y
CONFIG_CORTEX_M_SYSTICK=y
CONFIG_TICKLESS_KERNEL=y
CONFIG_SYS_CLOCK_HW_CYCLES_PER_SEC=2000000000

CONFIG_ISR_STACK_SIZE=16384
CONFIG_KOBJECT_TEXT_AREA=4096
CONFIG_HEAP_MEM_POOL_SIZE=4194304

CONFIG_NO_OPTIMIZATIONS=n
CONFIG_FPU_SHARING=n
```
